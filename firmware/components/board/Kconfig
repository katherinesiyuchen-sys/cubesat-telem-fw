## firmware/components/board/Kconfig
```kconfig
menu "CubeSat board pins"

config CUBESAT_PIN_STATUS_LED
    int "Status LED GPIO"
    range 0 48
    default 48

config CUBESAT_PIN_LORA_MOSI
    int "SX1262 MOSI GPIO"
    range 0 48
    default 11

config CUBESAT_PIN_LORA_MISO
    int "SX1262 MISO GPIO"
    range 0 48
    default 13

config CUBESAT_PIN_LORA_SCLK
    int "SX1262 SCLK GPIO"
    range 0 48
    default 12

config CUBESAT_PIN_LORA_CS
    int "SX1262 CS/NSS GPIO"
    range 0 48
    default 42

config CUBESAT_PIN_LORA_RESET
    int "SX1262 RESET GPIO"
    range 0 48
    default 2

config CUBESAT_PIN_LORA_BUSY
    int "SX1262 BUSY GPIO"
    range 0 48
    default 38

config CUBESAT_PIN_LORA_DIO1
    int "SX1262 DIO1 GPIO"
    range 0 48
    default 39

config CUBESAT_PIN_GNSS_TX
    int "ESP32 TX GPIO to GNSS RX"
    range 0 48
    default 7

config CUBESAT_PIN_GNSS_RX
    int "ESP32 RX GPIO from GNSS TX"
    range 0 48
    default 15

config CUBESAT_PIN_I2C_SDA
    int "I2C SDA GPIO"
    range 0 48
    default 4

config CUBESAT_PIN_I2C_SCL
    int "I2C SCL GPIO"
    range 0 48
    default 5

config CUBESAT_PIN_LORA_ENABLE
    int "SX1262 enable GPIO"
    range -1 48
    default 40

config CUBESAT_PIN_SENSORS_ENABLE
    int "Shared sensors enable GPIO"
    range -1 48
    default 21

config CUBESAT_PIN_IMU_CS
    int "IMU chip-select GPIO"
    range -1 48
    default 45

config CUBESAT_PIN_IMU_INTERRUPT
    int "IMU interrupt GPIO"
    range -1 48
    default 3

config CUBESAT_PIN_IMU_RESET
    int "IMU reset GPIO"
    range -1 48
    default 9

config CUBESAT_PIN_IMU_WAKE
    int "IMU wake GPIO"
    range -1 48
    default 46

config CUBESAT_PIN_GNSS_EXTINT
    int "GNSS EXTINT GPIO"
    range -1 48
    default 6

config CUBESAT_PIN_RTC_INT
    int "RTC interrupt GPIO"
    range -1 48
    default 1

config CUBESAT_PIN_SOLAR_IRRADIANCE
    int "Solar irradiance analog/digital GPIO"
    range -1 48
    default 47

config CUBESAT_PIN_USBC_ENABLE
    int "USB-C power enable GPIO"
    range -1 48
    default 14

config CUBESAT_PIN_FLASH_CS
    int "External flash chip-select GPIO"
    range -1 48
    default 8

config CUBESAT_PIN_GNSS_EN
    int "GNSS enable GPIO"
    range -1 48
    default 44
    help
        MAX-M10S GNSS rail enable/control line.

config CUBESAT_PIN_GNSS_RESET
    int "GNSS reset GPIO"
    range -1 48
    default 43
    help
        MAX-M10S reset line.

config CUBESAT_MCP23017_I2C_ADDR
    hex "MCP23017 pin extender I2C address"
    range 0x20 0x27
    default 0x20

config CUBESAT_PIN_MCP23017_INTA
    int "MCP23017 INTA GPIO"
    range -1 48
    default -1

config CUBESAT_PIN_MCP23017_INTB
    int "MCP23017 INTB GPIO"
    range -1 48
    default -1

config CUBESAT_NODE_ID
    int "CubeSat node ID"
    range 1 65535
    default 1

config CUBESAT_GROUND_ID
    int "Groundstation node ID"
    range 1 65535
    default 2

config CUBESAT_DEMO_SESSION_ID
    hex "Demo session ID"
    default 0x12345678

config CUBESAT_LORA_FREQUENCY_HZ
    int "LoRa frequency in Hz"
    range 100000000 1000000000
    default 915000000

config CUBESAT_LORA_SPREADING_FACTOR
    int "LoRa spreading factor"
    range 5 12
    default 7

config CUBESAT_LORA_BANDWIDTH_HZ
    int "LoRa bandwidth in Hz"
    range 7800 500000
    default 125000

config CUBESAT_LORA_CODING_RATE
    int "LoRa coding rate register value"
    range 1 4
    default 1
    help
        SX1262 LoRa coding-rate value. Use 1 for 4/5, 2 for 4/6, 3 for 4/7,
        and 4 for 4/8.

config CUBESAT_LORA_TX_POWER_DBM
    int "LoRa TX power in dBm"
    range -9 22
    default 14

config CUBESAT_GNSS_BAUDRATE
    int "GNSS UART baudrate"
    range 1200 921600
    default 9600

config CUBESAT_WIFI_SSID
    string "Backup Wi-Fi SSID"
    default ""
    help
        Lab backup transport SSID. Leave empty to disable Wi-Fi UDP backup.

config CUBESAT_WIFI_PASSWORD
    string "Backup Wi-Fi password"
    default ""

config CUBESAT_WIFI_GROUND_HOST
    string "Groundstation UDP host IPv4"
    default "192.168.1.100"
    help
        IPv4 address of the groundstation computer running Master Control.

config CUBESAT_WIFI_LOCAL_UDP_PORT
    int "ESP32 local UDP command port"
    range 1 65535
    default 5010

config CUBESAT_WIFI_GROUND_UDP_PORT
    int "Groundstation UDP telemetry port"
    range 1 65535
    default 5011

endmenu
```

## firmware/components/security/Kconfig
```kconfig
menu "CubeSat security"

config CUBESAT_USE_LIBOQS
    bool "Use liboqs for ML-KEM and ML-DSA"
    default n
    help
        Enable this after adding liboqs as an ESP-IDF component named "oqs".
        When disabled, the ML-KEM and ML-DSA APIs validate buffers but return
        ESP_ERR_NOT_SUPPORTED so demo firmware does not falsely claim lattice
        security.

config CUBESAT_REQUIRE_COMMAND_AUTH
    bool "Require lattice-derived command authentication"
    default n
    depends on CUBESAT_USE_LIBOQS
    help
        Reject command packets unless COMMAND_FLAG_AUTH_PRESENT is set and the
        tag verifies with keys derived from an established ML-KEM session.
        Leave this disabled for first radio bring-up so unauthenticated ping
        and self-test commands still work before pairing.

endmenu
```

## firmware/components/tasks/Kconfig
```kconfig
menu "CubeSat runtime"

config CUBESAT_FAKE_TELEMETRY_ON_GNSS_TIMEOUT
    bool "Transmit bench telemetry when GNSS has no fix"
    default y
    help
        Keeps the ESP32 demo runnable on a desk before the GNSS antenna has a
        valid fix. Disable this for the real GNSS-only milestone.

config CUBESAT_LOG_PACKET_HEX
    bool "Log encoded packet bytes as TX_HEX"
    default y
    help
        Prints each transmitted HOPE packet as a hex line on the ESP32 USB
        console. This is useful for comparing ESP32 output with RangePi serial
        packets.

config CUBESAT_BRINGUP_ONLY
    bool "Run hardware bring-up diagnostics only"
    default n
    help
        Runs the pin/SPI/SX1262/GNSS/I2C/security/NVS diagnostic loop without
        starting the normal telemetry tasks. Enable this while wiring a new
        ESP32 board.

choice CUBESAT_TRANSPORT_MODE
    prompt "Primary packet transport"
    default CUBESAT_TRANSPORT_MODE_LORA
    help
        Selects the packet carrier used by the telemetry task. The HOPE packet
        bytes stay identical; only the carrier changes.

config CUBESAT_TRANSPORT_MODE_LORA
    bool "LoRa SX1262 only"

config CUBESAT_TRANSPORT_MODE_WIFI_UDP
    bool "Wi-Fi UDP only"

config CUBESAT_TRANSPORT_MODE_AUTO
    bool "Auto fallback: LoRa primary, Wi-Fi UDP backup"

config CUBESAT_TRANSPORT_MODE_BLE_RESERVED
    bool "Bluetooth LE reserved"
    help
        Reserved for a future BLE GATT packet service. The current firmware logs
        the selection and falls back to LoRa/Wi-Fi behavior.

endchoice

config CUBESAT_TRANSPORT_AUTO_FAILS
    int "LoRa failures before Wi-Fi fallback"
    range 1 20
    default 3
    depends on CUBESAT_TRANSPORT_MODE_AUTO

endmenu
```

## firmware/sdkconfig.defaults
```kconfig
CONFIG_CUBESAT_USE_LIBOQS=n
CONFIG_CUBESAT_FAKE_TELEMETRY_ON_GNSS_TIMEOUT=y
CONFIG_CUBESAT_LOG_PACKET_HEX=y
CONFIG_CUBESAT_PIN_STATUS_LED=48
CONFIG_CUBESAT_PIN_LORA_MOSI=11
CONFIG_CUBESAT_PIN_LORA_MISO=13
CONFIG_CUBESAT_PIN_LORA_SCLK=12
CONFIG_CUBESAT_PIN_LORA_CS=42
CONFIG_CUBESAT_PIN_LORA_RESET=2
CONFIG_CUBESAT_PIN_LORA_BUSY=38
CONFIG_CUBESAT_PIN_LORA_DIO1=39
CONFIG_CUBESAT_PIN_GNSS_TX=7
CONFIG_CUBESAT_PIN_GNSS_RX=15
CONFIG_CUBESAT_PIN_I2C_SDA=4
CONFIG_CUBESAT_PIN_I2C_SCL=5
CONFIG_CUBESAT_PIN_LORA_ENABLE=40
CONFIG_CUBESAT_PIN_SENSORS_ENABLE=21
CONFIG_CUBESAT_PIN_IMU_CS=45
CONFIG_CUBESAT_PIN_IMU_INTERRUPT=3
CONFIG_CUBESAT_PIN_IMU_RESET=9
CONFIG_CUBESAT_PIN_IMU_WAKE=46
CONFIG_CUBESAT_PIN_GNSS_EXTINT=6
CONFIG_CUBESAT_PIN_RTC_INT=1
CONFIG_CUBESAT_PIN_SOLAR_IRRADIANCE=47
CONFIG_CUBESAT_PIN_USBC_ENABLE=14
CONFIG_CUBESAT_PIN_FLASH_CS=8
CONFIG_CUBESAT_PIN_GNSS_EN=44
CONFIG_CUBESAT_PIN_GNSS_RESET=43
CONFIG_CUBESAT_MCP23017_I2C_ADDR=0x20
CONFIG_CUBESAT_PIN_MCP23017_INTA=-1
CONFIG_CUBESAT_PIN_MCP23017_INTB=-1
CONFIG_ESPTOOLPY_FLASHSIZE_16MB=y
# CONFIG_ESPTOOLPY_FLASHSIZE_2MB is not set
# CONFIG_ESP_CONSOLE_UART_DEFAULT is not set
# CONFIG_ESP_CONSOLE_USB_CDC is not set
CONFIG_ESP_CONSOLE_USB_SERIAL_JTAG=y
# CONFIG_ESP_CONSOLE_UART_CUSTOM is not set
# CONFIG_ESP_CONSOLE_NONE is not set
CONFIG_ESP_CONSOLE_SECONDARY_NONE=y
# CONFIG_ESP_CONSOLE_SECONDARY_USB_SERIAL_JTAG is not set
CONFIG_ESP_CONSOLE_USB_SERIAL_JTAG_ENABLED=y
# CONFIG_ESP_CONSOLE_UART is not set
CONFIG_CUBESAT_NODE_ID=1
CONFIG_CUBESAT_GROUND_ID=2
CONFIG_CUBESAT_DEMO_SESSION_ID=0x12345678
CONFIG_CUBESAT_LORA_FREQUENCY_HZ=915000000
CONFIG_CUBESAT_LORA_SPREADING_FACTOR=7
CONFIG_CUBESAT_LORA_BANDWIDTH_HZ=125000
CONFIG_CUBESAT_LORA_CODING_RATE=1
CONFIG_CUBESAT_LORA_TX_POWER_DBM=14
CONFIG_CUBESAT_GNSS_BAUDRATE=9600
```
